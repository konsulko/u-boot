## board/raisonance/stm32-primer/Kconfig
```kconfig
if TARGET_STM32_PRIMER

config SYS_BOARD
	string
	default "stm32-primer"

config SYS_VENDOR
	string
	default "raisonance"

config SYS_SOC
	string
	default "stm32f1"

config SYS_CONFIG_NAME
	string
	default "stm32-primer"

endif
```

## board/st/stm3210e-eval/Kconfig
```kconfig
if TARGET_STM3210E_EVAL

config SYS_BOARD
	string
	default "stm3210e-eval"

config SYS_VENDOR
	string
	default "st"

config SYS_SOC
	string
	default "stm32f1"

config SYS_CONFIG_NAME
	string
	default "stm3210e-eval"

endif
```
